## config/boards/shields/unidart/Kconfig.defconfig
```kconfig
# Copyright (c) 2020 The ZMK Contributors
# SPDX-License-Identifier: MIT

if SHIELD_UNIDART

config ZMK_KEYBOARD_NAME
    default "Unidart"

endif
```
